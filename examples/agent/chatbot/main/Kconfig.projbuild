## examples/agent/chatbot/main/Kconfig.projbuild
```kconfig
menu "Example Configuration"
    config EXAMPLE_USE_DAFEIYU_EXPRESSIONS
        bool "Use Dafeiyu character animations"
        default y
        help
            Replace the chatbot's shared expression assets with the Dafeiyu
            character from QCYTSN/dsh-dafeiyu. Includes local EAF animations
            for the supported display resolutions. Disable to use stock faces.

    config EXAMPLE_DAFEIYU_CLOSEUP_ENABLE
        bool "Enable Dafeiyu voice-controlled close-up view"
        depends on EXAMPLE_USE_DAFEIYU_EXPRESSIONS
        default y
        help
            Say "进入贴脸模式" to play a gradual camera move into a face
            close-up, or "退出贴脸模式" to return to a full-body view.
            Uses an alternate, shorter set of full/face animation loops to
            keep the existing 3000 KiB anim_icon partition size unchanged.
            Rebuild and flash both the firmware and the animation partition.

    config EXAMPLE_DAFEIYU_SMOOTH_32M
        bool "Use 20 fps Dafeiyu close-up animations (S3, 32 MB, 360x360)"
        depends on EXAMPLE_DAFEIYU_CLOSEUP_ENABLE && IDF_TARGET_ESP32S3 && ESPTOOLPY_FLASHSIZE_32MB && SPIRAM && SPIRAM_USE_MALLOC
        default n
        help
            Select continuous 20 fps close-up frames and a 24-frame camera move.
            Requires a 360x360 panel and at least 12 MiB in anim_icon; use
            partitions_32m.csv. Display bus and audio concurrency must be tested
            on hardware. This does not change board pins or PSRAM clock settings.

    menuconfig EXAMPLE_AGENTS_ENABLE_COZE
        bool "Enable Coze agent"
        select BROOKESIA_AGENT_COZE_ENABLE_AUTO_REGISTER
        default n

    if EXAMPLE_AGENTS_ENABLE_COZE
        config EXAMPLE_AGENTS_COZE_APP_ID
            string "App ID"
            default "110049xxxxxxx"

        config EXAMPLE_AGENTS_COZE_PUBLIC_KEY
            string "Public key"
            default "lsKjtB67xxxxxxxxxxxxxxxxxxxxxxxxxxxxxxxxxxx"

        config EXAMPLE_AGENTS_COZE_PRIVATE_KEY_FILE_PATH
            string "Private key"
            default "./private_key.pem"

        config EXAMPLE_AGENTS_COZE_CUSTOM_CONSUMER
            string "Custom consumer (Optional)"
            default ""

        menuconfig EXAMPLE_AGENTS_COZE_BOT1_ENABLE
            bool "Bot 1"
            default y

        if EXAMPLE_AGENTS_COZE_BOT1_ENABLE
            config EXAMPLE_AGENTS_COZE_BOT1_NAME
                string "Bot name"
                default "Lin Jia Nv Hai"

            config EXAMPLE_AGENTS_COZE_BOT1_ID
                string "Bot ID"
                default "7516538xxxxxxxxxxxx"

            config EXAMPLE_AGENTS_COZE_BOT1_DESCRIPTION
                string "Bot description"
                default "A warm-voiced female AI character who listens to the user's thoughts and offers comforting responses."

            config EXAMPLE_AGENTS_COZE_BOT1_VOICE_ID
                string "Bot voice ID"
                default "7426720361733144585"
        endif

        menuconfig EXAMPLE_AGENTS_COZE_BOT2_ENABLE
            bool "Bot 2"
            default n

        if EXAMPLE_AGENTS_COZE_BOT2_ENABLE
            config EXAMPLE_AGENTS_COZE_BOT2_NAME
                string "Bot name"
                default "Wan Qu Da Shu"

            config EXAMPLE_AGENTS_COZE_BOT2_ID
                string "Bot ID"
                default "7516538xxxxxxxxxxxx"

            config EXAMPLE_AGENTS_COZE_BOT2_DESCRIPTION
                string "Bot description"
                default "A male AI character with a regional accent. He responds quickly and concisely, but does not perform actions on behalf of the user."

            config EXAMPLE_AGENTS_COZE_BOT2_VOICE_ID
                string "Bot voice ID"
                default "7426720361732915209"
        endif
    endif

    menuconfig EXAMPLE_AGENTS_ENABLE_OPENAI
        bool "Enable OpenAI agent"
        select BROOKESIA_AGENT_OPENAI_ENABLE_AUTO_REGISTER
        default n

    if EXAMPLE_AGENTS_ENABLE_OPENAI
        config EXAMPLE_AGENTS_OPENAI_API_KEY
            string "API key"
            default "sk-proj-xxx"

        config EXAMPLE_AGENTS_OPENAI_MODEL
            string "Model"
            default "gpt-realtime-2"

        config EXAMPLE_AGENTS_OPENAI_VOICE
            string "Voice"
            default "alloy"
    endif

    menuconfig EXAMPLE_AGENTS_ENABLE_XIAOZHI
        bool "Enable Xiaozhi agent"
        select BROOKESIA_AGENT_XIAOZHI_ENABLE_AUTO_REGISTER
        default y

    menuconfig EXAMPLE_DSH_PET_SYNC_ENABLE
        bool "Enable direct DSH pet state push and local MCP status"
        depends on EXAMPLE_USE_DAFEIYU_EXPRESSIONS
        default n
        help
            Receive dsh-pet work status directly from a DSH Host plugin and
            display local animations. No Python bridge or cloud call is needed
            for animation sync. If Xiaozhi is enabled, its DSH.GetStatus tool
            reads the pushed snapshot locally.

    if EXAMPLE_DSH_PET_SYNC_ENABLE
        config EXAMPLE_DSH_PET_SYNC_PORT
            int "DSH push receiver TCP port"
            range 1024 65535
            default 8766

        config EXAMPLE_DSH_PET_SYNC_TOKEN
            string "DSH push receiver access token"
            default ""
            help
                Use the same 24-128 character URL-safe token in the DSH plugin
                configuration. An empty or invalid token disables the receiver.
    endif

    menuconfig EXAMPLE_DSH_BRIDGE_ENABLE
        bool "Enable DSH desktop status MCP tool"
        depends on EXAMPLE_AGENTS_ENABLE_XIAOZHI
        depends on !EXAMPLE_DSH_PET_SYNC_ENABLE
        default n
        help
            Query the PC bridge for dsh-pet work status and current task text.
            Install dsh-pet in DSH and run tools/dsh_bridge.py on the same PC.
            The plugin API does not provide project names or todo counts.

    if EXAMPLE_DSH_BRIDGE_ENABLE
        config EXAMPLE_DSH_BRIDGE_URL
            string "PC bridge base URL (http://LAN-IP:8765)"
            default ""

        config EXAMPLE_DSH_BRIDGE_TOKEN
            string "PC bridge access token"
            default ""
            help
                Copy the token from the bridge's local token file. This is a
                bridge-specific token, not a DeepSeek API key or DSH credential.
    endif
endmenu
```
